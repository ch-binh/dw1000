## CMakeLists.txt
```
cmake_minimum_required(VERSION 3.20.0)
find_package(Zephyr REQUIRED HINTS $ENV{ZEPHYR_BASE})

project(basic)

# NORDIC SDK APP START
### INCLUDE ###

# own sources
target_include_directories(app PRIVATE ${CMAKE_SOURCE_DIR}/inc)
# common sources

# peripherals sources

# sensor driver sources
target_include_directories(app PRIVATE ${CMAKE_SOURCE_DIR}/../../../../inc)


### SOURCE ###
# own sources
FILE(GLOB app_sources src/*.c)
# common sources
FILE(GLOB dw1000_sources ../../../../src/*.c)
# peripherals sources

# sensor driver



### INCLUDE TO BUILD ###
target_sources(app PRIVATE ${app_sources})
target_sources(app PRIVATE ${dw1000_sources})

# NORDIC SDK APP END
```

## prj.conf
```kconfig
CONFIG_SPI=y
```

## src/main.c
```c
/* Zephyr lib */
#include <zephyr/kernel.h>
#include <zephyr/sys/printk.h>
/* Application specific submodules */
#include "main.h"
#include "hal_spi.h"

/* Application common lib */

/* Sensor driver lib */
#include "dw1000.h"

extern struct spi_dt_spec spispec;

void hal_hw_dw1000_init(void)
{
	dw1000_ops_t ops = {
		.write = hal_spi_write,
		.write_read = hal_spi_write_read};
	dw1000_set_hw_spec(&ops);
}

static int main_setup(void)
{
	printk("[%s] Initializing...\n", __func__);
	hal_spi_init();
	hal_hw_dw1000_init();

	dw1000_modify_pan_id_and_short_addr(DW_NETWORK_ID, DW_SHORT_ADDR);
	dw1000_write_pan_id_and_short_addr();

	printk("[%s] Setup complete...\n", __func__);
}

int main(void)
{
	main_setup();

	char msg[128];
	dw1000_dbg_get_msg_dev_id(msg);
	printk("%s", msg);
	dw1000_dbg_get_msg_dev_uuid(msg);
	printk("%s", msg);
	dw1000_dbg_get_msg_dev_pan_id_short_add(msg);
	printk("%s", msg);

	if (dw1000_check_dev_id() < 0)
	{
		printk("Wrong device ID\n");
	}
	else
	{
		printk("Correct device ID\n");
	}

	dw1000_set_leds_high();
	// GPIOS 0 1 2 3 should be high

	//dw1000_cfg_sysctrl_tx_start();

	while (1)
	{
		k_sleep(K_FOREVER);
	}

	return 0;
}
```

## inc/hal_spi.h
```c
#ifndef HAL_SPI_H
#define HAL_SPI_H

#include "main.h"

#define SPIOP SPI_WORD_SET(8) | SPI_TRANSFER_MSB


extern struct spi_dt_spec spispec;

int hal_spi_init(void);

void hal_hw_rfm_init(void);
int hal_spi_write_reg(uint8_t reg, uint8_t value);
int hal_spi_write(uint8_t *reg, uint8_t reg_size, uint8_t *data, uint8_t size);
int hal_spi_write_read(uint8_t *reg, uint8_t reg_size, uint8_t *data, uint8_t size);

#endif // HAL_SPI_H
```

## src/hal_spi.c
```c
#include <zephyr/kernel.h>
#include <zephyr/drivers/spi.h>

#include "hal_spi.h"

struct spi_dt_spec spispec = SPI_DT_SPEC_GET(DT_NODELABEL(dw1000), SPIOP, 0);

int hal_spi_init(void)
{
    if (!device_is_ready(spispec.bus))
    {
        return -1;
    }
    return 0;
}

int hal_spi_deinit(void)
{
    return 0;
}

int hal_spi_write_reg(uint8_t reg, uint8_t value)
{
    uint8_t tx_buf[] = {(reg | 0x80), value};
    struct spi_buf tx_spi_buf = {.buf = tx_buf, .len = sizeof(tx_buf)};
    struct spi_buf_set tx_spi_buf_set = {.buffers = &tx_spi_buf, .count = 1};

    int err = spi_write_dt(&spispec, &tx_spi_buf_set);
    if (err < 0)
    {
        return err;
    }

    return 0;
}

int hal_spi_write(uint8_t *reg, uint8_t reg_size, uint8_t *data, uint8_t size)
{
    uint8_t tx_buf[reg_size + size]; // Buffer for register + data
    
    reg[0] |= 0x80; // write bit

    if (reg_size == 2) // if main reg + 1 sub reg, bit 6 of main reg is 1
    {
        reg[0] |= 0x40;
    }
    else if (reg_size == 3) // if main reg + 2 sub regs, bit 6 of main and bit 7 of sub reg 1 = 1
    {
        reg[0] |= 0x40;
        reg[1] |= 0x80;
    }

    memcpy(tx_buf, reg, reg_size);         // Copy register address first
    memcpy(tx_buf + reg_size, data, size); // Copy data after register

    struct spi_buf tx_spi_buf = {.buf = tx_buf, .len = reg_size + size};
    struct spi_buf_set tx_spi_buf_set = {.buffers = &tx_spi_buf, .count = 1};

    int err = spi_write_dt(&spispec, &tx_spi_buf_set);
    if (err < 0)
    {
        return err;
    }

    return 0;
}

int hal_spi_write_read(uint8_t *reg, uint8_t reg_size, uint8_t *data, uint8_t size)
{   
    uint8_t tx_buffer[reg_size];      // Adjust buffer size based on register size
    if (reg_size == 2) // if main reg + 1 sub reg, bit 6 of main reg is 1
    {
        reg[0] |= 0x40;
    }
    else if (reg_size == 3) // if main reg + 2 sub regs, bit 6 of main and bit 7 of sub reg 1 = 1
    {
        reg[0] |= 0x40;
        reg[1] |= 0x80;
    }

    
    memcpy(tx_buffer, reg, reg_size); // Copy multi-byte register address

    struct spi_buf tx_spi_buf = {.buf = (void *)&tx_buffer, .len = reg_size};
    struct spi_buf_set tx_spi_buf_set = {.buffers = &tx_spi_buf, .count = 1};

    struct spi_buf rx_spi_bufs = {.buf = data, .len = size};
    struct spi_buf_set rx_spi_buf_set = {.buffers = &rx_spi_bufs, .count = 1};

    int err = spi_transceive_dt(&spispec, &tx_spi_buf_set, &rx_spi_buf_set);
    if (err < 0)
    {
        return err;
    }

    return 0;
}
```
